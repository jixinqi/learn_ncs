## boards/arm/laz_nrf52832/Kconfig.board
```kconfig
# Copyright (c) 2023 Nordic Semiconductor ASA
# SPDX-License-Identifier: Apache-2.0

config BOARD_LAZ_NRF52832
	bool "laz_nrf52832"
	depends on SOC_NRF52832_QFAA
```

## boards/arm/laz_nrf52832/Kconfig.defconfig
```kconfig
# Copyright (c) 2023 Nordic Semiconductor ASA
# SPDX-License-Identifier: Apache-2.0

if BOARD_LAZ_NRF52832

config BOARD
	default "laz_nrf52832"

config BT_CTLR
   default BT

endif
```
